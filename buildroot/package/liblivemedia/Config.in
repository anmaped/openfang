## buildroot/package/liblivemedia/Config.in
```kconfig
config BR2_PACKAGE_LIBLIVEMEDIA
	bool "liblivemedia"
	depends on BR2_LARGEFILE
	depends on BR2_USE_WCHAR
	select BR2_PACKAGE_GETTEXT if BR2_NEEDS_GETTEXT_IF_LOCALE
	help
	  liblivemedia
```

## buildroot/package/mtk-nvram/Config.in
```kconfig
menu "nvram Features"

config BR2_PACKAGE_MTD_NVRAM
	string "mtd name for nvram"
	default "Config"
endmenu
```

## buildroot/package/oss/Config.in
```kconfig
config BR2_PACKAGE_OSS
	bool "oss"
	depends on BR2_LARGEFILE
	depends on BR2_USE_WCHAR
	select BR2_PACKAGE_GETTEXT if BR2_NEEDS_GETTEXT_IF_LOCALE
	help
	  oss commands including ossplay and ossrecord
```

## buildroot/package/v4l2rtspserver/Config.in
```kconfig
config BR2_PACKAGE_V4L2RTSPSERVER
	bool "v4l2rtspserver"
	depends on BR2_LARGEFILE
	depends on BR2_USE_WCHAR
	select BR2_PACKAGE_GETTEXT if BR2_NEEDS_GETTEXT_IF_LOCALE
	help
	  v4l2rtspserver
```
